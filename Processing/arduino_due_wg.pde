import g4p_controls.*; //Libreria per gli elementi grafici

import processing.serial.*; //Seriale

int[] [] data = {
  // Sinusoidale
  {
    0x7ff, 0x86a, 0x8d5, 0x93f, 0x9a9, 0xa11, 0xa78, 0xadd, 0xb40, 0xba1,
    0xbff, 0xc5a, 0xcb2, 0xd08, 0xd59, 0xda7, 0xdf1, 0xe36, 0xe77, 0xeb4,
    0xeec, 0xf1f, 0xf4d, 0xf77, 0xf9a, 0xfb9, 0xfd2, 0xfe5, 0xff3, 0xffc,
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    0x3ff, 0x45d, 0x4be, 0x521, 0x586, 0x5ed, 0x655, 0x6bf, 0x729, 0x794
  }
  ,

  // Triangolare
  {
    0x44, 0x88, 0xcc, 0x110, 0x154, 0x198, 0x1dc, 0x220, 0x264, 0x2a8,
    0x2ec, 0x330, 0x374, 0x3b8, 0x3fc, 0x440, 0x484, 0x4c8, 0x50c, 0x550,
    0x594, 0x5d8, 0x61c, 0x660, 0x6a4, 0x6e8, 0x72c, 0x770, 0x7b4, 0x7f8,
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    0x264, 0x220, 0x1dc, 0x198, 0x154, 0x110, 0xcc, 0x88, 0x44, 0x0
  }
  ,

  // Dente di sega
  {
    0x22, 0x44, 0x66, 0x88, 0xaa, 0xcc, 0xee, 0x110, 0x132, 0x154,
    0x176, 0x198, 0x1ba, 0x1dc, 0x1fe, 0x220, 0x242, 0x264, 0x286, 0x2a8,
    0x2ca, 0x2ec, 0x30e, 0x330, 0x352, 0x374, 0x396, 0x3b8, 0x3da, 0x3fc,
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    0xebe, 0xee0, 0xf02, 0xf24, 0xf46, 0xf68, 0xf8a, 0xfac, 0xfce, 0xff0
  }
  ,

  // Onda quadra
  {
    0xfff, 0xfff, 0xfff, 0xfff, 0xfff, 0xfff, 0xfff, 0xfff, 0xfff, 0xfff,
    0xfff, 0xfff, 0xfff, 0xfff, 0xfff, 0xfff, 0xfff, 0xfff, 0xfff, 0xfff,
    0xfff, 0xfff, 0xfff, 0xfff, 0xfff, 0xfff, 0xfff, 0xfff, 0xfff, 0xfff,
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    0x0, 0x0, 0x0, 0x0, 0x0, 0x0, 0x0, 0x0, 0x0, 0x0
  }

};
  
public class punto{
  public float x;
  public float y;
}

int dataSel=0;

int larg = 30;
int lung = 80;

int newFreq = 1000, oldFreq = 1000;

float hp = 0.78f;
float wp = 0.83f;

int spazioLibero, spazioSotto;

punto mcord = new punto();

int[] data2 = new int[120];

Serial myPort;  

int sample = 120;

void setup() {
  
  size(displayWidth, displayHeight);
  
  spazioSotto = int(width*wp);

  spazioLibero = spazioSotto - (5 * lung);
  
  createGUI();

  String portName = Serial.list()[0];
  myPort = new Serial(this, portName, 115200);
  
  frameRate(240);
}

void draw() {
  
  background(255);
/*
  if(myPort.available() > 0){
  //  println("in"+myPort.readStringUntil(':'));
  }
*/
  
  //Cornice per la visualizzazione dell'onda

  strokeWeight(4); 
  stroke(255, 0, 0);
  line(0, height*hp, width*wp, height*hp);
  line(width*wp, height*hp, width*wp, 0);
  fill(0);
  strokeWeight(1); 
  
  //Se il mouse è premuto e sono nella forma personalizzata e sono all'interno dell'area allora registro il movimento

  if(mousePressed == true){
    if(dataSel == 0){
      if((mouseX < width * wp) && (mouseY < height * hp)){
        data2[constrain(int(map(mouseX, 0, width*wp, 0, sample)), 0, sample-1)] = int(map(mouseY, 0.0f, height*hp, 4095, 0));
        //println("x  "+mouseX+"\ty  "+int(map(mouseY, 0.0f, height, 4095,0)));
      }
    }
  }
  
  //Disegno l'onda scelta
  
  strokeWeight(2); 
  stroke(0, 255, 0);
  
  for(int i = 0; i < sample-1; i++){
    if(dataSel == 0) //Se l'onda personalizzata è attiva allora disegno il buffer data2
      line(int(map(i, 0, sample, 0, width*wp)), int(map(data2[i], 0, 4095, height*hp, 0)), int(map(i+1, 0, sample, 0, width*wp)), int(map(data2[i+1], 0, 4095, height*hp, 0)));
    else //In qualsiasi altro caso disegno l'onda selezionata
      line(int(map(i, 0, sample, 0, width*wp)), int(map(data[dataSel - 1][i], 0, 4095, height*hp, 0)), int(map(i+1, 0, sample, 0, width*wp)), int(map(data[dataSel - 1][i+1], 0, 4095, height*hp, 0)));
  }
  
  strokeWeight(1); 

  //Aggiorno e disegno le coordinate del mouse
  mcord.x = mouseX;
  mcord.y = mouseY;
  fill(0);
  drawCords(mcord);
  

}


void keyPressed(){
  if(key == 'x')
    exit();//Utilizzo il tasto x per uscire dal programma
}

void mouseReleased() { //quando il mouse viene rilasciato aggiorno i dati e la frequenza se necessario
  if(newFreq != oldFreq){
    oldFreq = newFreq;
    
    myPort.write('f');
    myPort.write(""+newFreq+';');
  }
  aggiorna();
  
}

void drawCords(punto cord){
  text(cord.x+"\n"+cord.y, mouseX+10,mouseY+10);
}

void aggiorna(){
  myPort.write('s');
  myPort.write(""+sample+';');
  
  for(int i = 0; i < sample; i++){
    if(dataSel == 0)
      myPort.write(""+data2[i]+';');
    else
      myPort.write(""+data[dataSel - 1][i]+';');
    //println("out"+data2[i]+';');
  }
}
